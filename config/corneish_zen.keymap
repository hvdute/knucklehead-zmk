/*
 * Copyright (c) 2020 The ZMK Contributors
 *
 * SPDX-License-Identifier: MIT
 */

#include "../knucklehead/base.dtsi"

/*
 * No `chosen { zmk,matrix_transform = ... }` here on purpose: selecting a bare
 * matrix transform disables ZMK physical layouts, which makes CONFIG_ZMK_STUDIO
 * fail to build (BUILD_ASSERT in physical_layouts.c). The Corne-ish Zen board
 * already chooses `zmk,physical-layout = &foostan_corne_6col_layout` and maps it
 * to `&default_transform`, so the matrix mapping is identical.
 */

