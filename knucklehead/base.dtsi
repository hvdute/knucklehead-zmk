// ZMK Core Includes
#include <behaviors.dtsi>
#include <behaviors/num_word.dtsi> // requires https://github.com/urob/zmk-auto-layer module
#include <dt-bindings/zmk/keys.h>
#include <dt-bindings/zmk/bt.h>
#include <dt-bindings/zmk/outputs.h>

// Layers
#define L1 0
#define L2 1
#define Fn 2

// Meh key
#define MEH LS(LC(LALT))

// tmux prefix key
#define TMUX_PREFIX LC(B)

// macos screenshots
// This will properly create the required CMD+CTRL+SHIFT+3/4 shortcuts that match macOS's system defaults. The `&kp` syntax ensures all modifiers are pressed simultaneously before the number key is pressed.
// Full screen to clipboard
#define S_SCRSHOT LCMD LC(LS(NUMBER_3))

// Selection to clipboard 
#define S_SCRSHOT LCMD LC(LS(NUMBER_4))

// Behaviors Constants
#define TAPPING_TERM_MS 280
#define QUICK_TAP_MS 175
#define REQUIRE_PRIOR_IDLE_MS 150

// Combos Constants
#define COMBO_TERM_DEFAULT 30
#define COMBO_QUICK_TAP_MS 100

// Key positions per hand
#define KEYS_L 0 1 2 3 4 5 12 13 14 15 16 17 24 25 26 27 28 29
#define KEYS_R 6 7 8 9 10 11 18 19 20 21 22 23 30 31 32 33 34 35
#define THUMBS 36 37 38 39 40 41

#include "behaviors.dtsi"
#include "macros.dtsi"
#include "combos.dtsi"

// Alpha layer: uncomment desired, comment the others
/* #include "L1_colemak-dh.dtsi" */
// #include "L1_colemak.dtsi"
// #include "L1_dvorak.dtsi"
#include "L1_qwerty.dtsi"

// Other layers
#include "L2.dtsi"
#include "Fn.dtsi"

